## main/Kconfig
```kconfig
menu "SCIENTISST Configuration"

choice
    prompt "Hardware version"
    default HARDWARE_VERSION_CORE

    config HARDWARE_VERSION_CORE
        bool "Core (default)"
        
    config HARDWARE_VERSION_NANO
        bool "Nano"

    config HARDWARE_VERSION_CARDIO
        bool "Cardio"
endchoice

menu "Communication Configuration"
    choice
        prompt "Communication mode"
        default DEFAULT_COM_MODE_BT

        config DEFAULT_COM_MODE_BT
            bool "Bluetooth (default)"
            
        config DEFAULT_COM_MODE_BLE
            bool "Bluetooth Low Energy"
            
        config DEFAULT_COM_MODE_TCP_AP
            bool "TCP Access Point"
            
        config DEFAULT_COM_MODE_TCP_STA
            bool "TCP Station"
            
        config DEFAULT_COM_MODE_UDP_STA
            bool "UDP Station"
            
        config DEFAULT_COM_MODE_SERIAL
            bool "USB"
            
        config DEFAULT_COM_MODE_WS_AP
            bool "WebSocket Access Point"
    endchoice

# Wi-Fi Configuration
    menu "Wi-Fi Configuration"
        visible if (DEFAULT_COM_MODE_UDP_STA || DEFAULT_COM_MODE_TCP_STA)

        config WIFI_SSID
            string "Wi-Fi SSID"
            default "riot"
            help
                Enter the SSID of the Wi-Fi network you want to connect to.

        config WIFI_PASSWORD
            string "Wi-Fi Password"
            default ""
            help
                Enter the password for the Wi-Fi network.

        config WIFI_HOST_IP
            string "Host IP"
            default "192.168.1.100"
            help
                Enter the IP of the host you want to connect to.

        config PORT
            string "Port"
            default "8800"
            help
                Enter the port of the device should connect to.
    endmenu  # Wi-Fi Configuration
endmenu # Communication Configuration

# External ADC Configuration
config ADC_EXT
    bool "Enable external ADC"
    default n
    help
        This option should only be enabled if an ext adc is present on the board.

# SD Card Configuration
menu "SD Card Configuration"
    config SD_CARD
        bool "Enable SD Card"
        default n

    config FORMAT_SDCARD_IF_MOUNT_FAILED
        depends on SD_CARD
        bool "Format SD Card if mount failed"
        default n

    config NUMBER_CHANNELS_EXT_ADC
        depends on SD_CARD
        int "Enter number of channels of external adc"
        default 0
        range 0 2
        help
            This option should be set to 0 unless an ext adc is present on the board and enabled.

endmenu  # SD Card Configuration

menu "IMU Configuration"
# IMU enable/disable setting
    config IMU
        bool "Enable IMU"
        default n
        help
            Enable or disable the IMU (Inertial Measurement Unit).
            If unsure, select 'n' to disable it.

# IMU Data Acquisition Modes
    choice 
        prompt "IMU Data channels AI1-AI3"
        depends on IMU
        default IMU_H1_NO_DATA

        config IMU_H1_NO_DATA
            bool "No data"
            help
                No data on AI1-AI3

        config IMU_H1_EULER_ANGLES
            bool "Euler angles"
            help
                Select this mode to acquire Euler angles data from the IMU on AI1-AI3.

        config IMU_H1_LINEAR_ACCELERATION
            bool "Linear acceleration"
            help
                Select this mode to acquire linear acceleration data from the IMU on AI1-AI3.

        config IMU_H1_ANGULAR_VELOCITY
            bool "Angular velocity and linear acceleration"
            help
                Select this mode to acquire angular velocity data from the IMU on AI1-AI3.

        config IMU_H1_MAGNETIC_FIELD
            bool "Magnetic field"
            help
                Select this mode to acquire magnetic field data from the IMU on AI1-AI3.

        config IMU_H1_GRAVITY
            bool "Gravity"
            help
                Select this mode to acquire gravity data from the IMU on AI1-AI3.

        config IMU_H1_ACCELERATION
            bool "Acceleration"
            help
                Select this mode to acquire acceleration data from the IMU on AI1-AI3.
    
        config IMU_H1_TEMPERATURE
            bool "Temperature"
            help
                Select this mode to acquire temperature data from the IMU on AI1-AI3.
    endchoice

    choice 
        prompt "IMU Data channels AI4-AI6"
        depends on IMU
        default IMU_H2_NO_DATA 

        config IMU_H2_NO_DATA
            bool "No data"
            help
                No data on AI4-AI6 

        config IMU_H_EULER_ANGLES
            bool "Euler angles"
            help
                Select this mode to acquire Euler angles data from the IMU on AI4-AI6.

        config IMU_H2_LINEAR_ACCELERATION
            bool "Linear acceleration"
            help
                Select this mode to acquire linear acceleration data from the IMU on AI4-AI6.

        config IMU_H2_ANGULAR_VELOCITY
            bool "Angular velocity and linear acceleration"
            help
                Select this mode to acquire angular velocity data from the IMU on AI4-AI6.

        config IMU_H2_MAGNETIC_FIELD
            bool "Magnetic field"
            help
                Select this mode to acquire magnetic field data from the IMU on AI1-AI3.

        config IMU_H2_GRAVITY
            bool "Gravity"
            help
                Select this mode to acquire gravity data from the IMU on AI1-AI3.

        config IMU_H2_ACCELERATION
            bool "Acceleration"
            help
                Select this mode to acquire acceleration data from the IMU on AI1-AI3.

        config IMU_H2_TEMPERATURE
            bool "Temperature"
            help
                Select this mode to acquire temperature data from the IMU on AI1-AI3.
    endchoice

# IMU Calibration Behavior
    choice
        prompt "IMU Calibration Behavior"
        depends on IMU
        default ALLOW_IMU_ACQUISITION_WHILE_CALIBRATING

        config LOCK_IMU_ACQUISITION_UNTIL_CALIBRATED
            bool "Lock IMU acquisition until calibrated"
            help
                Select this option to lock IMU data acquisition until the device is calibrated.

        config ALLOW_IMU_ACQUISITION_WHILE_CALIBRATING
            bool "Allow IMU acquisition while calibrating"
            help
                Select this option to allow IMU data acquisition even when the device is in the process of calibrating.
    endchoice
endmenu  # IMU Configuration

# Debug level/verbosity
choice 
    prompt "Debug level"
    default SCI_DEBUG_WARNINGS_AND_ERRORS

    config SCI_DEBUG_NO_DEBUGGING
        bool "0 - Nothing"

    config SCI_DEBUG_ERRORS
        bool "1 - Print Errors"

    config SCI_DEBUG_WARNINGS_AND_ERRORS
        bool "2 - Print Warnings and Errors (default)"

    config SCI_DEBUG_INFO_WARNINGS_AND_ERRORS
        bool "3 - Print Info, Warnings and Errors"

endchoice

config PREVENT_ACQUISITION_ON_LOW_BATTERY
    bool "Prevent acquisition on low battery"
    default n
    help
        When on low battery, the sensor data has an increased error margin. This option forces the device to stop the acquisition and restart when that happens.
        It will become virtually unusable until it is charged above a certain threshold. Unfortunately, this only works for non-wifi modes.


endmenu  # SCI Configuration
```

## sdkconfig.defaults
```kconfig
#
# Compiler options
#
CONFIG_COMPILER_OPTIMIZATION_PERF=y

#
# ESP32-specific
#
CONFIG_ESP32_DEFAULT_CPU_FREQ_240=y
CONFIG_ESP32_DEFAULT_CPU_FREQ_MHZ=240

# Override some defaults so BT stack is enabled
# and WiFi disabled by default in this example
CONFIG_BT_ENABLED=y
CONFIG_BTDM_CTRL_MODE_BLE_ONLY=n
CONFIG_BTDM_CTRL_MODE_BR_EDR_ONLY=y
CONFIG_BTDM_CTRL_MODE_BTDM=n
CONFIG_BT_CLASSIC_ENABLED=y
CONFIG_BT_SPP_ENABLED=y
CONFIG_BT_BLE_ENABLED=n
CONFIG_BT_ACL_CONNECTIONS=2
CONFIG_BT_MULTI_CONNECTION_ENBALE=n

#
# Restful Server Defautls
#
CONFIG_HTTPD_MAX_REQ_HDR_LEN=1024
CONFIG_SPIFFS_OBJ_NAME_LEN=64
CONFIG_FATFS_LONG_FILENAME=y
CONFIG_FATFS_LFN_HEAP=y
CONFIG_ESPTOOLPY_FLASHSIZE_4MB=y
CONFIG_PARTITION_TABLE_CUSTOM=y
CONFIG_PARTITION_TABLE_CUSTOM_FILENAME="partitions_example.csv"
CONFIG_PARTITION_TABLE_FILENAME="partitions_example.csv"

#
# Websocket
#
CONFIG_HTTPD_WS_SUPPORT=y
CONFIG_ESP_HTTPS_SERVER_ENABLE=y

#
# LWIP
#
CONFIG_LWIP_MAX_SOCKETS=16
# The configs below are recommended for max throughput in https://docs.espressif.com/projects/esp-idf/en/latest/esp32/api-guides/lwip.html#maximum-throughput
CONFIG_LWIP_TCPIP_TASK_AFFINITY_CPU0=y
CONFIG_LWIP_ETHARP_TRUST_IP_MAC=n
CONFIG_LWIP_IRAM_OPTIMIZATION=y
# In order to save some memory, since IPv6 is not used
CONFIG_LWIP_IPV6=n

#
# Wi-Fi
#
CONFIG_ESP32_WIFI_RX_IRAM_OPT=n
```
